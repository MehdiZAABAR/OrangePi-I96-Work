## meta-rda8810/conf/layer.conf
```bitbake
# We have a conf and classes directory, add to BBPATH
BBPATH .= ":${LAYERDIR}"

# We have recipes-* directories, add to BBFILES
BBFILES += "${LAYERDIR}/recipes-*/*/*.bb ${LAYERDIR}/recipes-*/*/*.bbappend"

BBFILE_COLLECTIONS += "rda8810"
BBFILE_PATTERN_rda8810 = "^${LAYERDIR}/"
BBFILE_PRIORITY_rda8810 = "1"

# This should only be incremented on significant changes that will
# cause compatibility issues with other layers
LAYERVERSION_rda8810 = "1"

LAYERDEPENDS_rda8810 = "core"

LAYERSERIES_COMPAT_rda8810 = "dunfell"
```

## meta-rda8810/conf/machine/include/bootloaders.inc
```bitbake
# Add bootloaders to the images of every machine
#OLD LINE ####EXTRA_IMAGEDEPENDS += "at91bootstrap virtual/bootloader"
EXTRA_IMAGEDEPENDS += "virtual/bootloader"
```

## meta-rda8810/conf/machine/include/rda8810pl.inc
```bitbake
# RDA8810PL  defaults
require RDA8810.inc

SOC_FAMILY = "rda8810:rda8810pl"

DEFAULTTUNE = "cortexa5thf-neon-vfpv4"
```

## meta-rda8810/conf/machine/orangepi-i96.conf
```bitbake
#@TYPE: Machine
#@Name: RDA OrangePi I96
#@DESCRIPTION: Machine configuration for OrangePi I96 basd on RDA8810pl chip

require include/rda8810.inc

MACHINE_FEATURES = "apm alsa ext2 ext3 usbhost usbgadget screen touchscreen"
KERNEL_DEVICETREE = "orangepi-i96.dtb"

IMAGE_FSTYPES += " ubi tar.gz"

# NAND
MKUBIFS_ARGS = " -e 0x3e000 -c 2082 -m 0x1000 -x lzo"
UBINIZE_ARGS = " -m 0x1000 -p 0x40000"
MKENVIMAGE_EXTRA_ARGS = " -r "

UBI_VOLNAME = "rootfs"

UBOOT_MACHINE ?= "${MACHINE}_nandflash_config"
UBOOT_ENTRYPOINT = "0x20008000"
UBOOT_LOADADDRESS = "0x20008000"
UBOOT_ENV_SIZE = "0x20000"
```
